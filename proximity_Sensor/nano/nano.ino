#include <ServoTimer2.h>
#include <CapacitiveSensor.h>
#include <PCM.h>
#include <movingAvg.h>

ServoTimer2 servoLeft, servoRight;  // Create a servo object

// capacitive sensing constant
CapacitiveSensor sensor = CapacitiveSensor(8,5);  // 1,5M resistor between pins 8 & 2, pin 2 is sensor pin

// capacitance noise filter
movingAvg touch(10);

// initial sound message
const unsigned char sample[] PROGMEM = {
  129, 130, 130, 130, 130, 129, 128, 128, 127, 127, 128, 130,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 127,     
};

// Sensor reading range (analog values)
const int sensorMin = 10;
const int sensorMax = 1023;

// Desired output range in Hz
const int outputMin = 800;
const int outputMax = 1500;

#define LED_PIN 12
#define BUTTON_PIN 2

volatile byte alarmState = HIGH;

const int servoLeftPin = 9;   // Digital pin for left servo
const int servoRightPin = 10; // Digital pin for right servo

const int numAxes = 3;      // Number of axes (x, y, z)
char receivedData[50];      // Buffer to store received data
int axisValues[numAxes];    // Array to store parsed axis values

int pitch = 0;
int roll = 0;

int servoLeftAngle = 0;
int servoRightAngle = 0;

// These constants won't change:
const int photocell = A0;  // pin that the sensor is attached to

// Variables for light sensor:
int lightValue = 0;   // the sensor value
int lightMin = 1023;  // minimum sensor value
int lightMax = 0;     // maximum sensor value
int darknessThreshold = 0;  // to turn the light on

void setup() {
  Serial.begin(57600);

  pinMode(photocell, INPUT);

  pinMode(LED_PIN, OUTPUT);

  touch.begin();

  // turn on LED to signal the start of the calibration period:
  digitalWrite(LED_PIN, HIGH);
  
  // calibrate during the first five seconds
  while (millis() < 5000) {
    lightValue = analogRead(photocell);

    // record the maximum sensor value
    if (lightValue > lightMax) {
      lightMax = lightValue;
    }

    // record the minimum sensor value
    if (lightValue < lightMin) {
      lightMin = lightValue;
    }
  }

  darknessThreshold = (lightMin + lightMax)/2 ;

  // signal the end of the calibration period
  digitalWrite(LED_PIN, LOW);

  // play sound message welcome in the beginning
  startPlayback(sample, sizeof(sample));
  
  // for the button to change from alarm to drive stage
  pinMode(BUTTON_PIN, INPUT);
  attachInterrupt(digitalPinToInterrupt(BUTTON_PIN), states, RISING);
}

void loop() {
  if(!alarmState)
    alarm();
  else if(alarmState){
    drive();
    lights();
  }
}

void states() {
  alarmState = !alarmState;
  servoLeft.detach();
  servoRight.detach();
  if (alarmState) {
    // call this to stop sound alarm
    noTone(11);
  }
}

void alarm() {
  // call this because PCM somehow interferences Capacitance 
  stopPlayback();
  
   // read the sensor value
  long sensorVal = sensor.capacitiveSensor(30);

  int _sampleAvg = touch.reading(sensorVal);    // calculate the moving average
  
  // in case the sensor value is outside the range seen during calibration
  _sampleAvg = constrain(_sampleAvg, sensorMin, sensorMax);

  // Map the sensor value to the desired output range
  int mappedValue = map(_sampleAvg, sensorMin, sensorMax, outputMin, outputMax);

  // play a sine wave at frequency mappedValue
  tone(11, mappedValue);

  // fit function "y = 2E+17x^(-5,609)" to map sensor value into distance
  double y = 200000000000000000 * pow(mappedValue, -5.609);

  // write proximity into serial
  Serial.print("Proximity: ");
  Serial.print(y);
  Serial.println(" cm");

  delay(50); // read samples at ~20Hz (once every 50ms)
}

void drive(){
  // read received accelerometer values from Esp32 via UART protocol
  if (Serial.available()) {
    
    // Read the incoming data until a newline character is received
    int bytesRead = Serial.readBytesUntil('\n', receivedData, sizeof(receivedData) - 1);
    receivedData[bytesRead] = '\0'; // Null-terminate the string

    // Parse the received data
    char *token = strtok(receivedData, "\t");
    for (int i = 0; i < numAxes && token != nullptr; i++) {
      // Check if the token contains a valid float value
      float floatValue = atof(token); // Convert string to float
      if (!isnan(floatValue)) {
        axisValues[i] = floatValue;
        token = strtok(nullptr, "\t");
      }
      else {
        // Skip this token and move to the next one
        token = strtok(nullptr, "\t");
      }
    }

    // Now axisValues array contains the parsed float values
    float accX = axisValues[0];
    float accY = axisValues[1];
    float accZ = axisValues[2];

    // Calculate pitch and roll angles from accelerometer data
    pitch = atan2(-accX, sqrt(accY * accY + accZ * accZ)) * 180.0 / PI;
    roll = atan2(accY, accZ) * 180.0 / PI;
  }

  // Calculate the absolute value of pitch and roll
  int absolutePitch = abs(pitch);
  int absoluteRoll = abs(roll);
  
  // Map the pitch and roll angles to pwm values range 750-2250
  // front-back
  if(absolutePitch>absoluteRoll){
    servoLeftAngle = map(pitch, -90, 90, 2250, 750);
    servoRightAngle = map(pitch, -90, 90, 750, 2250);
  }

  // left-right
  else if(absoluteRoll>absolutePitch){
    servoLeftAngle = map(roll, -90, 90, 750, 2250);
    servoRightAngle = map(roll, -90, 90, 750, 2250);
  }

  // enable servos
  if((absolutePitch>30)||(absoluteRoll>30)){
    servoLeft.attach(servoLeftPin);
    servoRight.attach(servoRightPin);
  }

  // disable servos
  else if((absolutePitch<=30)&&(absoluteRoll<=30)){
    servoLeft.detach();
    servoRight.detach();
  }

  // Constrain servo angles to valid range
  servoLeftAngle = constrain(servoLeftAngle, 750, 2250);
  servoRightAngle = constrain(servoRightAngle, 750, 2250);

  // Set servo positions
  servoLeft.write(servoLeftAngle);
  servoRight.write(servoRightAngle);

  delay(20); // Adjust delay as needed
}

void lights(){
  // read the sensor:
  lightValue = analogRead(photocell);

  if (lightValue >= darknessThreshold) {
    digitalWrite(LED_PIN,LOW);
  } 
  else if (lightValue < darknessThreshold) {
    digitalWrite(LED_PIN,HIGH);
  }
  delay(20);
}
